## drivers/input/fingerprint/fpc_mi/Kconfig
```kconfig
#-----------------------------------#
#    Kconfig for FingerprintCard    #
#-----------------------------------#

config FPC_FINGERPRINT_MI
	default n
	tristate "fpc1020 fingerprint driver"
```

## drivers/input/fingerprint/goodix_mi/Kconfig
```kconfig
config GOODIX_FINGERPRINT_MI
	tristate "generic goodix fingerprint driver"
	default n
	help
	add support for goodix fingerprint driver.
```
